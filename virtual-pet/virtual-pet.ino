#include <Arduboy2.h>
#include <EEPROM.h>

// Libraries objects
Arduboy2 arduboy;
Sprites sprites;

// Global variables
int gamestate = 0;
int Ajustpressed = 0;
int Bjustpressed = 0;

// Creature base stats
float food = 100.0;
float water = 100.0;
float happiness = 100.0;
float sleep = 100.0;
float health = 100.0;

// Creature global status
String status = "alive";
bool alreadyDied = 0;

// Animazioni
byte frame = 0;
byte catPosition = 85;

/**
 *    SPRITE
 *  ANIMATIONS

 *  CAT_WALKING_1
 * 
 * */
const unsigned char PROGMEM cat_walking_1[] = {

  // width, height,
  44, 32,

  // FRAME 00
  0x00, 0x00, 0x00, 0x00, 0x00, 0x00, 0x00, 0x00, 0x80, 0x80, 0x80, 0x80,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 0x00, 
  0x00, 0x00, 0x00, 0x00, 0x00, 0x00, 0x00, 0x00, 0x00, 0x00, 0x00, 0x00,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 0x00, 
  0x00, 0x00, 0x00, 0x00, 0x00, 0x00, 0x00, 0x00, 0x07, 0x07, 0x07, 0x07,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 0xe0, 
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  0x07, 0x07, 0x07, 0x07, 0x1f, 0x1f, 0x1f, 0x1f, 0x7f, 0x7f, 0x7f, 0x7f,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 0x00, 

  // FRAME 01
  0x00, 0x00, 0x00, 0x00, 0x00, 0x00, 0x00, 0x00, 0x00, 0x00, 0x00, 0x00,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 0x00, 
  0x00, 0x00, 0x00, 0x00, 0x00, 0x00, 0x00, 0x00, 0x00, 0x00, 0x00, 0x00,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 0x00, 
  0x00, 0x00, 0x00, 0x00, 0x00, 0x00, 0x00, 0x00, 0x1e, 0x1e, 0x1e, 0x1e,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 0x80, 
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  0x79, 0x79, 0x79, 0x79, 0x7f, 0x7f, 0x7f, 0x7f, 0x1f, 0x1f, 0x1f, 0x1f,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 0x00, 

  // FRAME 02
  0x00, 0x00, 0x00, 0x00, 0x00, 0x00, 0x00, 0x00, 0x80, 0x80, 0x80, 0x80,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 0x00, 
  0x00, 0x00, 0x00, 0x00, 0x00, 0x00, 0x00, 0x00, 0x00, 0x00, 0x00, 0x00,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 0x00, 
  0x00, 0x00, 0x00, 0x00, 0x00, 0x00, 0x00, 0x00, 0x07, 0x07, 0x07, 0x07,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 0xe0, 
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  0x00, 0x00, 0x00, 0x00, 0x01, 0x01, 0x01, 0x01, 0x79, 0x79, 0x79, 0x79,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 0x00, 

  // FRAME 03
  0x00, 0x00, 0x00, 0x00, 0x00, 0x00, 0x00, 0x00, 0x80, 0x80, 0x80, 0x80,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 0x00, 
  0x00, 0x00, 0x00, 0x00, 0x00, 0x00, 0x00, 0x00, 0x06, 0x06, 0x06, 0x06,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 0x00, 
  0x00, 0x00, 0x00, 0x00, 0x00, 0x00, 0x00, 0x00, 0x07, 0x07, 0x07, 0x07,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 0xe0, 
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  0x07, 0x07, 0x07, 0x07, 0x1f, 0x1f, 0x1f, 0x1f, 0x7f, 0x7f, 0x7f, 0x7f,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 0x00, 

  // FRAME 04
  0x00, 0x00, 0x00, 0x00, 0x00, 0x00, 0x00, 0x00, 0x00, 0x00, 0x00, 0x00,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 0x00, 
  0x00, 0x00, 0x00, 0x00, 0x00, 0x00, 0x00, 0x00, 0x00, 0x00, 0x60, 0x60,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 0x00, 
  0x00, 0x00, 0x00, 0x00, 0x00, 0x00, 0x00, 0x00, 0x00, 0x00, 0x1e, 0x1e,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 0x80, 
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  0x01, 0x01, 0x79, 0x79, 0x79, 0x79, 0x7f, 0x7f, 0x7f, 0x7f, 0x1f, 0x1f,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 0x00, 

  // FRAME 05
  0x00, 0x00, 0x00, 0x00, 0x00, 0x00, 0x00, 0x00, 0x80, 0x80, 0x80, 0x80,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 0x00, 
  0x00, 0x00, 0x00, 0x00, 0x00, 0x00, 0x00, 0x00, 0x00, 0x00, 0x00, 0x00,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 0x00, 
  0x00, 0x00, 0x00, 0x00, 0x00, 0x00, 0x00, 0x00, 0x07, 0x07, 0x07, 0x07,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 0xe0, 
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  0x00, 0x00, 0x00, 0x00, 0x01, 0x01, 0x01, 0x01, 0x79, 0x79, 0x79, 0x79,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 0x00,
};

/** 
 * Setup code:
 * - Prepare arudboy library
 * - Load game data from EEPROM
 **/
void setup()
{
  // Ready the arduboy library
  // TODO: minimize code using arduboy.boot()
  arduboy.begin(); 
  arduboy.setFrameRate(30);
  arduboy.clear();

  // Load game data from EEPROM
  loadGame();
}

/**
 * Main game loop
 **/
void loop()
{
  // Only render next frame when it's actually time to
  if (!arduboy.nextFrame()) return;

  // Clears display buffer back to BLACK before next loop
  arduboy.clear();

  // Save game data
  saveGame();  

  switch(gamestate){

    // Starting splashscreen
    // TODO: create a proper artsy splashscreen that will last 2-3 seconds
    case 0:
      arduboy.setRGBled(0, 0, 0);
      arduboy.setCursor(0, 07);
      arduboy.print("DON'T LET THE CAT DIE");
      arduboy.setCursor(15, 20);
      arduboy.print("press A to start");
      arduboy.setCursor(15, 30);
      arduboy.print("press B for stats");
      arduboy.setCursor(15, 40);
      arduboy.print("press UP to cheat");
      arduboy.setCursor(45, 53);
      arduboy.print("by Fieel");
      break;

    // Main game with the animated cat
    // TODO: everything else, this is just a test
    case 1:
      // Reset cursor position
      arduboy.setCursor(0, 0);

      // TODO: Draw background
      // (An appartment room maybe?)

      // Draw the alive cat sprite
      if(!isDead()){
        
        // Using the walking cat sprite animation
        sprites.drawPlusMask(catPosition, 30, cat_walking_1, frame);
        
        // Animate the cat every 12 frames cycling the sprite animation 
        if (arduboy.everyXFrames(12)) {
          frame++;

          // tmp: slowly move the cat
          if(catPosition >= 1 && !isDead()){
            catPosition--;
          }
        }
        if (frame > 5) frame = 0; // manages the sprite animation loop
      } else {
        // Dead cat
        // TODO: proper sprite
        sprites.drawPlusMask(catPosition, 40, cat_walking_1, 0);
      }

      break;

    // Show data and stats in this screen
    case 2:
      arduboy.setCursor(70, 0);
      arduboy.print(food);
      arduboy.setCursor(70, 10);
      arduboy.print(water);
      arduboy.setCursor(70, 20);
      arduboy.print(happiness);
      arduboy.setCursor(70, 30);
      arduboy.print(sleep);
      arduboy.setCursor(70, 40);
      arduboy.print(health);
      arduboy.setCursor(0, 0);
      arduboy.print("food:");
      arduboy.setCursor(0, 10);
      arduboy.print("water:");
      arduboy.setCursor(0, 20);
      arduboy.print("happiness:");
      arduboy.setCursor(0, 30);
      arduboy.print("sleep:");
      arduboy.setCursor(0, 40);
      arduboy.print("health:");
      arduboy.setCursor(0, 54);
      arduboy.print("Status:");
      arduboy.setCursor(70, 54);
      arduboy.print(status);
      break;
  }

  /**
   *  ********GLOBAL EVENTS*********
   *  Stuff that happens everysingle loop
   *  Regardless of game mode.
   * 
   **/
  timePasses(); // Lower stats over time
  isDead(); // Check if cat is dead
  checkForButtonPresses(); // Check for button presses

  // Copy data from the display buffer and update the screen
  arduboy.display();
}

/**
 * Check if the creature is dead
 * Updates the "stats" variable and returns a bool
 * Can be used for both ¯\_(ツ)_/¯
 **/
boolean isDead(){
  if(food < 0.0){
    status = "food :(";
    alreadyDied = 1;
    return true;
  } else if(water < 0.0){
    status = "water :(";
    alreadyDied = 1;
    return true;
  } else if(happiness < 0.0){
    status = "Sad :( :(";
    alreadyDied = 1;
    return true;
  } else if(sleep < 0.0 ){
    status = "no sleep :(";
    alreadyDied = 1;
    return true;
  } else if (health < 0.0){
    status = "sick :(";
    alreadyDied = 1;
    return true;
  } else if (alreadyDied == 1) {
    status = "undead";
    return false;
  } else {
    return false;
  }
}

/**
 * Lowers stats over time
 * TODO: lower stats following some logic, now it's random for debug purposes
 * */
void timePasses(){
  if(rand()%2){
    if(water >= -10){
      water -= 0.003;
    }
  } else {
    if(food >= -10){
      food -= 0.002;
    }
    if(sleep >= -10){
      sleep -= 0.001;
    }
  }
  
  // TODO: give meaning to these stats lol
  happiness = (food + water + sleep) / 3;
  health = (food + water + happiness + sleep) / 4;
}

/**
 * Listens for button presses
 * */
void checkForButtonPresses(){

      // Change gamemode using A and B
      if(arduboy.pressed(A_BUTTON) and Ajustpressed == 0) {
        Ajustpressed = 1;
        gamestate = 1;
      }
      if(arduboy.pressed(B_BUTTON) and Bjustpressed == 0) {
        Bjustpressed = 1;
        gamestate = 2;
      }

      // tmp: move cat, just for fun
      if(arduboy.pressed(LEFT_BUTTON) && !isDead()) {
        if(catPosition >= 1){
          catPosition--;
        }
      }
      if(arduboy.pressed(RIGHT_BUTTON) && !isDead()) {
        if(catPosition <= 85){
          catPosition++;
        }
      }

      // tmp: raise stats by using up button
      if(arduboy.pressed(UP_BUTTON)) {

        if(food <= 100){
          food += 0.05;
        } else {
          food = 100;
        }

        if(water <= 100){
          water += 0.05;
        } else {
          water = 100;
        }

        if(sleep <= 100){
          sleep += 0.05;
        } else {
          sleep = 100;
        }

        if(happiness <= 100){
          happiness += 0.05;
        } else {
          happiness = 100;
        }

        if(health <= 100){
          health += 0.05;
        } else {
          health = 100;
        }
      }


      
  //Check if the A button is being held down
  if(arduboy.notPressed(A_BUTTON)) {
    Ajustpressed = 0;
  }
  
  //Check if the B button is being held down
  if(arduboy.notPressed(B_BUTTON)) {
    Bjustpressed = 0;
  }
}

/**
 * Save game data every x frames
 **/
void saveGame() {
  if (arduboy.everyXFrames(255)) {
    EEPROM.update(100, water);
    EEPROM.update(101, food);
    EEPROM.update(102, happiness);
    EEPROM.update(103, sleep);
    EEPROM.update(104, health);
  }
}

/**
 * Load game data from EEPRON and refresh stats
 **/
void loadGame() {
    water = (float) EEPROM.read(100);
    food = (float) EEPROM.read(101);
    happiness = (float) EEPROM.read(102);
    sleep = (float) EEPROM.read(103);
    health = (float) EEPROM.read(104);
}